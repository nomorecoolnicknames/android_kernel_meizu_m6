## drivers/input/fingerprint/Kconfig
```kconfig
#
#Fingerprint
#
menu "Fingerprint support"
	depends on INPUT

config MTK_FINGERPRINT_SUPPORT
	bool "Mediatek Fingerprint"
	default n
	---help---
	Fingerprint mtk driver enable/disable in the kernel.
	Say Y here if you want to use mediatek fingerprint driver,
	fingerprint driver will support fingerprint function
if MTK_FINGERPRINT_SUPPORT
config MTK_FINGERPRINT_SELECT
	string "sensor type"
	default "fingerprint"


if MTK_FINGERPRINT_SELECT = "FPC1145"
config FPC_FINGERPRINT
	bool "FPC Fingerprint"
	default y
	---help---
	FPC fingerprint FPC's 102x/104x device.
endif
# add by changjingyang start
#Gionee <GN_BSP_FP> <sunwave> <2017-02-22> add for sunwave fingerprint, start
if MTK_FINGERPRINT_SELECT = "sunwave"

config SUNWAVE_FINGERPRINT
       tristate "Sunwave Fingerprint"
       default y
       ---help---
       sunwave fingerprint device.
endif
#Gionee <GN_BSP_FP> <sunwave> <2017-02-22> add for sunwave fingerprint, end
#Gionee <GN_BSP_FP> <silead_fp> <2017-02-06> add for silead fingerprint, start
# add by changjingyang end
if MTK_FINGERPRINT_SELECT = "fingerprint"
config HUAWEI_FINGERPRINT
	bool "Huawei Fingerprint"
	default y
	---help---
	Huawei Fingerprint chip GOODIX/SILEAD TEE driver
config GOODIX_FINGERPRINT
	bool "Goodix Fingerprint"
	default y
	---help---
	Goodix Fingerprint chip GF316M/GF318M/GF3118M/GF518M/GF5118M/GF516M/GF816M/GF3208/GF5216 TEE driver

config GOODIX_SENSOR_TYPE
	string "SENSOR_TYPE"
	default "GF318M"
	---help---
	Must input sensor type, or default is GF316M GF318M GF3118M GF518M GF5118M GF516M GF816M GF3208 GF5216
endif
endif
endmenu
```

## drivers/misc/mediatek/accelerometer/mc3416/Kconfig
```kconfig
config MTK_MC3416
	tristate "MC34x6 for MediaTek package"
	default n
	help
	  It support different accelerometer sensor.
          If this option is set,
	  it will support
          MC34x6 Accelerometer.
```

## drivers/misc/mediatek/captouch/Kconfig
```kconfig
config CUSTOM_KERNEL_CAPSENSOR
	bool "LCT_CUSTOM_KERNEL_CAPSENSOR"
	default n
	help
	It support different type sensor
	in this platform. If this option
	is set, it will support ambient
	and light sensor MTK_SX9310.

source "drivers/misc/mediatek/captouch/sx9310/Kconfig"
```

## drivers/misc/mediatek/captouch/sx9310/Kconfig
```kconfig
config CAPSENSOR_SX931X
	bool "MTK_SX9310 for MediaTek package"
	default n
	help
	It support different type sensor
	in this platform. If this option
	is set, it will support ambient
	and light sensor MTK_SX9310.
```

## drivers/misc/mediatek/magnetometer/mmc3680x/Kconfig
```kconfig
config MTK_MMC3680X
	bool "MMC3680X for MediaTek package"
	default y
	help
	  It support different magnetometer sensor.
          If this option is set,
	  it will support
          MMC3680X magnetometer.
```

## kernel-3.18/drivers/devdetect/Kconfig
```kconfig
#
# Near Field Communication (NFC) devices
#
config HUAWEI_HW_I2C_DCT
	bool "huawei hw dev dct"
	default n
	help
	  Say yes if you want i2c device detect driver.
```

## kernel-3.18/drivers/misc/mediatek/accelerometer/bma4xy/Kconfig
```kconfig
#
# Makefile for Bosch sensors driver.
#

config MTK_BMA4XY
	bool "MTK_BMA4XY for MediaTek package"
	default n
```

## kernel-3.18/drivers/misc/mediatek/magnetometer/st480mc-new/Kconfig
```kconfig
config MTK_ST480_NEW
	bool "ST480 for MediaTek package"
	default n
	help
	  It support different magnetometer sensor.
          If this option is set,
	  it will support
          ST480 magnetometer.
```
